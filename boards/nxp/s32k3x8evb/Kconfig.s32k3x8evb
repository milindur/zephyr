## boards/nxp/s32k3x8evb/Kconfig.s32k3x8evb
```kconfig
# Copyright 2026 NXP
# SPDX-License-Identifier: Apache-2.0

config BOARD_S32K3X8EVB
	select SOC_S32K358
	select SOC_PART_NUMBER_S32K358GHT1MJBST
```

## boards/nxp/s32k3x8evb/board.yml
```yaml
board:
  name: s32k3x8evb
  full_name: S32K3X8EVB-Q289
  vendor: nxp
  socs:
    - name: s32k358
```
